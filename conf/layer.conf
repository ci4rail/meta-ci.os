## conf/layer.conf
```bitbake
# We have a conf and classes directory, append to BBPATH
BBPATH .= ":${LAYERDIR}"

# We have recipes-* directories, add to BBFILES
BBFILES += "${LAYERDIR}/recipes-*/*/*.bb ${LAYERDIR}/recipes-*/*/*.bbappend"

BBFILE_COLLECTIONS += "meta-ci.os"
BBFILE_PATTERN_meta-ci.os = "^${LAYERDIR}/"
BBFILE_PRIORITY_meta-ci.os = "24"

LAYERDEPENDS_meta-ci.os = "core"
LAYERSERIES_COMPAT_meta-ci.os = "zeus dunfell"

BB_DANGLINGAPPENDS_WARNONLY = "true"
```
